#include <PN532_I2C.h>
#include <Arduino.h>
#include <PN532.h>
#include <NfcAdapter.h>
#include <Wire.h>
#include <MicroLCD.h>
#include <ArduinoJson.h>

DynamicJsonDocument doc(1024);
PN532_I2C pn532i2c(Wire);
PN532 nfc(pn532i2c);
LCD_SH1106 lcd;
const PROGMEM uint8_t logo[48 * 48 / 8] = {
  0x00, 0x00, 0x00, 0x00, 0x00, 0x00, 0x00, 0x80, 0xC0, 0x60, 0x30, 0x98, 0x98, 0xCC, 0x6C, 0x66,
  0x36, 0x32, 0x12, 0x1B, 0x1B, 0x1B, 0x19, 0x19, 0x01, 0x01, 0x03, 0x1B, 0x1B, 0x03, 0x02, 0x36,
  0x26, 0x04, 0x8C, 0xD8, 0x18, 0x30, 0x60, 0xE0, 0xC0, 0x80, 0x00, 0x00, 0x00, 0x00, 0x00, 0x00,
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  0x26, 0x36, 0x33, 0x19, 0x09, 0x0C, 0x06, 0x03, 0x01, 0x00, 0x00, 0x00, 0x00, 0x00, 0x00, 0x00
};
char str[100];
void setup() {
  Serial.begin(9600);
  nfc.begin();
  lcd.begin();
  uint32_t versiondata = nfc.getFirmwareVersion();
  do {
    lcd.clear();
    lcd.setFontSize(FONT_SIZE_SMALL);
    lcd.println("Sensor Nao Encontrado");
    delay(1000);
  } while (!versiondata);
  // kontrola načtené verze NFC modulu
  if (!versiondata) {
    Serial.println("Modulo não encontrado!");
    // zastavení programu
    while (1);
  }
  else {
    lcd.clear();
    lcd.setCursor(40, 1);
    lcd.draw(logo, 48, 48);
    delay(1000);
  }

  nfc.setPassiveActivationRetries(0xFF);

  nfc.SAMConfig();

  lcd.clear();
  lcd.setCursor(1, 0);
  lcd.setFontSize(FONT_SIZE_SMALL);
  lcd.print("Carregando...");
  while (!Serial.available()) {
    delay(200);
  }

}

void loop() {
  boolean uspech;
  uint8_t uid[] = { 0, 0, 0, 0, 0, 0, 0 };
  uint8_t uidLength;

  uspech = nfc.readPassiveTargetID(PN532_MIFARE_ISO14443A, &uid[0], &uidLength);

  if (uspech) {
    String tag = "";
    for (uint8_t i = 0; i < uidLength; i++) {
      tag += String(uid[i], HEX);
    }
    delay(100);
    lcd.clear();
    lcd.setCursor(5, 1);
    lcd.setFontSize(FONT_SIZE_SMALL);
    lcd.println("Tag Lida");
    Serial.print(tag);

    while (!Serial.available()) {
      String msg = Serial.readString();

      deserializeJson(doc, msg);
      JsonObject obj = doc.as<JsonObject>();
      bool sucesso = obj["sucesso"];

      if (sucesso) {
        String nome = obj["data"]["nome"];
        String dia = obj["data"]["dia"];
        String hora = obj["data"]["hora"];
        lcd.clear();
        lcd.setCursor(5, 0);
        lcd.setFontSize(FONT_SIZE_SMALL);
        lcd.println(hora);
        lcd.setFontSize(FONT_SIZE_SMALL);
        lcd.println(dia);
        lcd.setFontSize(FONT_SIZE_MEDIUM);
        lcd.println("Ola: ");
        lcd.setFontSize(FONT_SIZE_SMALL);
        lcd.println(nome);
        delay(2000);
      } else {
        lcd.clear();
        lcd.setCursor(5, 1);
        lcd.setFontSize(FONT_SIZE_SMALL);
        lcd.println("Tag Nao Cadastrada");
        delay(2000);
      }
    }
  }


  lcd.clear();
  lcd.setCursor(40, 1);
  lcd.draw(logo, 48, 48);
  delay(100);
}
